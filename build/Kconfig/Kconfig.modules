## build/Kconfig/Kconfig.modules
```kconfig
menu "nrf (/home/vinter/ncs/nrf)"
osource "/home/vinter/ncs/nrf/Kconfig.nrf"
config ZEPHYR_NRF_MODULE
	bool
	default y
endmenu
menu "mcuboot (/home/vinter/ncs/bootloader/mcuboot)"
osource "$(ZEPHYR_MCUBOOT_KCONFIG)"
config ZEPHYR_MCUBOOT_MODULE
	bool
	default y
endmenu
menu "mbedtls (/home/vinter/ncs/modules/crypto/mbedtls)"
osource "$(ZEPHYR_MBEDTLS_KCONFIG)"
config ZEPHYR_MBEDTLS_MODULE
	bool
	default y
endmenu
menu "oberon-psa-crypto (/home/vinter/ncs/modules/crypto/oberon-psa-crypto)"
osource "/home/vinter/ncs/modules/crypto/oberon-psa-crypto/Kconfig.oberon_psa_crypto"
config ZEPHYR_OBERON_PSA_CRYPTO_MODULE
	bool
	default y
endmenu
menu "trusted-firmware-m (/home/vinter/ncs/modules/tee/tf-m/trusted-firmware-m)"
osource "$(ZEPHYR_TRUSTED_FIRMWARE_M_KCONFIG)"
config ZEPHYR_TRUSTED_FIRMWARE_M_MODULE
	bool
	default y
endmenu
config ZEPHYR_PSA_ARCH_TESTS_MODULE
   bool
   default y
config ZEPHYR_SOC_HWMV1_MODULE
   bool
   default y
menu "cjson (/home/vinter/ncs/modules/lib/cjson)"
osource "$(ZEPHYR_CJSON_KCONFIG)"
config ZEPHYR_CJSON_MODULE
	bool
	default y
endmenu
menu "azure-sdk-for-c (/home/vinter/ncs/modules/lib/azure-sdk-for-c)"
osource "$(ZEPHYR_AZURE_SDK_FOR_C_KCONFIG)"
config ZEPHYR_AZURE_SDK_FOR_C_MODULE
	bool
	default y
endmenu
menu "cirrus-logic (/home/vinter/ncs/modules/hal/cirrus-logic)"
osource "/home/vinter/ncs/modules/hal/cirrus-logic/Kconfig"
config ZEPHYR_CIRRUS_LOGIC_MODULE
	bool
	default y
endmenu
menu "openthread (/home/vinter/ncs/modules/lib/openthread)"
osource "$(ZEPHYR_OPENTHREAD_KCONFIG)"
config ZEPHYR_OPENTHREAD_MODULE
	bool
	default y
endmenu
menu "suit-generator (/home/vinter/ncs/modules/lib/suit-generator)"
osource "/home/vinter/ncs/modules/lib/suit-generator/ncs/Kconfig"
config ZEPHYR_SUIT_GENERATOR_MODULE
	bool
	default y
endmenu
menu "suit-processor (/home/vinter/ncs/modules/lib/suit-processor)"
osource "/home/vinter/ncs/modules/lib/suit-processor/Kconfig"
config ZEPHYR_SUIT_PROCESSOR_MODULE
	bool
	default y
endmenu
menu "memfault-firmware-sdk (/home/vinter/ncs/modules/lib/memfault-firmware-sdk)"
osource "/home/vinter/ncs/modules/lib/memfault-firmware-sdk/ports/zephyr/Kconfig"
config ZEPHYR_MEMFAULT_FIRMWARE_SDK_MODULE
	bool
	default y
endmenu
menu "coremark (/home/vinter/ncs/modules/benchmark/coremark)"
osource "$(ZEPHYR_COREMARK_KCONFIG)"
config ZEPHYR_COREMARK_MODULE
	bool
	default y
endmenu
menu "canopennode (/home/vinter/ncs/modules/lib/canopennode)"
osource "$(ZEPHYR_CANOPENNODE_KCONFIG)"
config ZEPHYR_CANOPENNODE_MODULE
	bool
	default y
endmenu
menu "chre (/home/vinter/ncs/modules/lib/chre)"
osource "/home/vinter/ncs/modules/lib/chre/platform/zephyr/Kconfig"
config ZEPHYR_CHRE_MODULE
	bool
	default y
endmenu
menu "lz4 (/home/vinter/ncs/modules/lib/lz4)"
osource "$(ZEPHYR_LZ4_KCONFIG)"
config ZEPHYR_LZ4_MODULE
	bool
	default y
endmenu
menu "nanopb (/home/vinter/ncs/modules/lib/nanopb)"
osource "$(ZEPHYR_NANOPB_KCONFIG)"
config ZEPHYR_NANOPB_MODULE
	bool
	default y
endmenu
config ZEPHYR_TF_M_TESTS_MODULE
   bool
   default y
menu "zscilib (/home/vinter/ncs/modules/lib/zscilib)"
osource "/home/vinter/ncs/modules/lib/zscilib/Kconfig.zscilib"
config ZEPHYR_ZSCILIB_MODULE
	bool
	default y
endmenu
menu "cmsis (/home/vinter/ncs/modules/hal/cmsis)"
osource "$(ZEPHYR_CMSIS_KCONFIG)"
config ZEPHYR_CMSIS_MODULE
	bool
	default y
endmenu
menu "cmsis-dsp (/home/vinter/ncs/modules/lib/cmsis-dsp)"
osource "$(ZEPHYR_CMSIS_DSP_KCONFIG)"
config ZEPHYR_CMSIS_DSP_MODULE
	bool
	default y
endmenu
menu "cmsis-nn (/home/vinter/ncs/modules/lib/cmsis-nn)"
osource "$(ZEPHYR_CMSIS_NN_KCONFIG)"
config ZEPHYR_CMSIS_NN_MODULE
	bool
	default y
endmenu
menu "fatfs (/home/vinter/ncs/modules/fs/fatfs)"
osource "$(ZEPHYR_FATFS_KCONFIG)"
config ZEPHYR_FATFS_MODULE
	bool
	default y
endmenu
menu "hal_nordic (/home/vinter/ncs/modules/hal/nordic)"
osource "$(ZEPHYR_HAL_NORDIC_KCONFIG)"
config ZEPHYR_HAL_NORDIC_MODULE
	bool
	default y
endmenu
menu "hal_st (/home/vinter/ncs/modules/hal/st)"
osource "$(ZEPHYR_HAL_ST_KCONFIG)"
config ZEPHYR_HAL_ST_MODULE
	bool
	default y
endmenu
config ZEPHYR_HAL_WURTHELEKTRONIK_MODULE
   bool
   default y
config ZEPHYR_LIBMETAL_MODULE
   bool
   default y
menu "liblc3 (/home/vinter/ncs/modules/lib/liblc3)"
osource "$(ZEPHYR_LIBLC3_KCONFIG)"
config ZEPHYR_LIBLC3_MODULE
	bool
	default y
endmenu
menu "littlefs (/home/vinter/ncs/modules/fs/littlefs)"
osource "$(ZEPHYR_LITTLEFS_KCONFIG)"
config ZEPHYR_LITTLEFS_MODULE
	bool
	default y
endmenu
menu "loramac-node (/home/vinter/ncs/modules/lib/loramac-node)"
osource "$(ZEPHYR_LORAMAC_NODE_KCONFIG)"
config ZEPHYR_LORAMAC_NODE_MODULE
	bool
	default y
endmenu
menu "lvgl (/home/vinter/ncs/modules/lib/gui/lvgl)"
osource "/home/vinter/ncs/modules/lib/gui/lvgl/Kconfig"
config ZEPHYR_LVGL_MODULE
	bool
	default y
endmenu
config ZEPHYR_MIPI_SYS_T_MODULE
   bool
   default y
config ZEPHYR_NRF_HW_MODELS_MODULE
   bool
   default y
config ZEPHYR_OPEN_AMP_MODULE
   bool
   default y
menu "picolibc (/home/vinter/ncs/modules/lib/picolibc)"
osource "/home/vinter/ncs/modules/lib/picolibc/zephyr/Kconfig"
config ZEPHYR_PICOLIBC_MODULE
	bool
	default y
endmenu
menu "segger (/home/vinter/ncs/modules/debug/segger)"
osource "$(ZEPHYR_SEGGER_KCONFIG)"
config ZEPHYR_SEGGER_MODULE
	bool
	default y
endmenu
config ZEPHYR_TINYCRYPT_MODULE
   bool
   default y
menu "uoscore-uedhoc (/home/vinter/ncs/modules/lib/uoscore-uedhoc)"
osource "$(ZEPHYR_UOSCORE_UEDHOC_KCONFIG)"
config ZEPHYR_UOSCORE_UEDHOC_MODULE
	bool
	default y
endmenu
menu "zcbor (/home/vinter/ncs/modules/lib/zcbor)"
osource "$(ZEPHYR_ZCBOR_KCONFIG)"
config ZEPHYR_ZCBOR_MODULE
	bool
	default y
endmenu
menu "nrfxlib (/home/vinter/ncs/nrfxlib)"
osource "/home/vinter/ncs/nrfxlib/Kconfig.nrfxlib"
config ZEPHYR_NRFXLIB_MODULE
	bool
	default y
endmenu
menu "connectedhomeip (/home/vinter/ncs/modules/lib/matter)"
osource "/home/vinter/ncs/modules/lib/matter/config/nrfconnect/chip-module/Kconfig"
config ZEPHYR_CONNECTEDHOMEIP_MODULE
	bool
	default y
endmenu
```

## build/Kconfig/Kconfig.shield
```kconfig
osource "/home/vinter/claude1/boards/shields/*/Kconfig.shield"
osource "/home/vinter/ncs/nrf/boards/shields/*/Kconfig.shield"
```

## build/Kconfig/Kconfig.shield.defconfig
```kconfig
osource "/home/vinter/claude1/boards/shields/*/Kconfig.defconfig"
osource "/home/vinter/ncs/nrf/boards/shields/*/Kconfig.defconfig"
```

## build/Kconfig/arch/Kconfig
```kconfig
# Load arch Kconfig descriptions.
osource "/home/vinter/ncs/zephyr/arch/x86/Kconfig"
osource "/home/vinter/ncs/zephyr/arch/xtensa/Kconfig"
osource "/home/vinter/ncs/zephyr/arch/sparc/Kconfig"
osource "/home/vinter/ncs/zephyr/arch/riscv/Kconfig"
osource "/home/vinter/ncs/zephyr/arch/posix/Kconfig"
osource "/home/vinter/ncs/zephyr/arch/nios2/Kconfig"
osource "/home/vinter/ncs/zephyr/arch/mips/Kconfig"
osource "/home/vinter/ncs/zephyr/arch/arm64/Kconfig"
osource "/home/vinter/ncs/zephyr/arch/arm/Kconfig"
osource "/home/vinter/ncs/zephyr/arch/arc/Kconfig"
```

## build/Kconfig/soc/Kconfig
```kconfig
# Load Zephyr SoC Kconfig descriptions.
osource "/home/vinter/ncs/zephyr/soc/xlnx/zynqmp/Kconfig"
osource "/home/vinter/ncs/zephyr/soc/xlnx/zynq7000/Kconfig"
osource "/home/vinter/ncs/zephyr/soc/xen/Kconfig"
osource "/home/vinter/ncs/zephyr/soc/ti/simplelink/Kconfig"
osource "/home/vinter/ncs/zephyr/soc/ti/lm3s6965/Kconfig"
osource "/home/vinter/ncs/zephyr/soc/ti/k3/Kconfig"
osource "/home/vinter/ncs/zephyr/soc/telink/tlsr/Kconfig"
osource "/home/vinter/ncs/zephyr/soc/starfive/jh71xx/Kconfig"
osource "/home/vinter/ncs/zephyr/soc/st/stm32/Kconfig"
osource "/home/vinter/ncs/zephyr/soc/snps/qemu_arc/Kconfig"
osource "/home/vinter/ncs/zephyr/soc/snps/nsim/Kconfig"
osource "/home/vinter/ncs/zephyr/soc/snps/hsdk4xd/Kconfig"
osource "/home/vinter/ncs/zephyr/soc/snps/hsdk/Kconfig"
osource "/home/vinter/ncs/zephyr/soc/snps/emsk/Kconfig"
osource "/home/vinter/ncs/zephyr/soc/snps/emsdp/Kconfig"
osource "/home/vinter/ncs/zephyr/soc/snps/arc_iot/Kconfig"
osource "/home/vinter/ncs/zephyr/soc/silabs/Kconfig"
osource "/home/vinter/ncs/zephyr/soc/sifive/sifive_freedom/Kconfig"
osource "/home/vinter/ncs/zephyr/soc/rockchip/Kconfig"
osource "/home/vinter/ncs/zephyr/soc/renode/riscv_virtual/Kconfig"
osource "/home/vinter/ncs/zephyr/soc/renesas/smartbond/Kconfig"
osource "/home/vinter/ncs/zephyr/soc/renesas/rzt2m/Kconfig"
osource "/home/vinter/ncs/zephyr/soc/renesas/rcar/Kconfig"
osource "/home/vinter/ncs/zephyr/soc/renesas/ra/Kconfig"
osource "/home/vinter/ncs/zephyr/soc/raspberrypi/Kconfig"
osource "/home/vinter/ncs/zephyr/soc/quicklogic/eos_s3/Kconfig"
osource "/home/vinter/ncs/zephyr/soc/qemu/virt_riscv/Kconfig"
osource "/home/vinter/ncs/zephyr/soc/qemu/malta/Kconfig"
osource "/home/vinter/ncs/zephyr/soc/openisa/rv32m1/Kconfig"
osource "/home/vinter/ncs/zephyr/soc/nxp/s32/Kconfig"
osource "/home/vinter/ncs/zephyr/soc/nxp/rw/Kconfig"
osource "/home/vinter/ncs/zephyr/soc/nxp/mcx/Kconfig"
osource "/home/vinter/ncs/zephyr/soc/nxp/lpc/Kconfig"
osource "/home/vinter/ncs/zephyr/soc/nxp/layerscape/Kconfig"
osource "/home/vinter/ncs/zephyr/soc/nxp/kinetis/Kconfig"
osource "/home/vinter/ncs/zephyr/soc/nxp/imxrt/Kconfig"
osource "/home/vinter/ncs/zephyr/soc/nxp/imx/Kconfig"
osource "/home/vinter/ncs/zephyr/soc/nuvoton/numicro/Kconfig"
osource "/home/vinter/ncs/zephyr/soc/nuvoton/numaker/Kconfig"
osource "/home/vinter/ncs/zephyr/soc/nuvoton/npcx/Kconfig"
osource "/home/vinter/ncs/zephyr/soc/nordic/Kconfig"
osource "/home/vinter/ncs/zephyr/soc/neorv32/Kconfig"
osource "/home/vinter/ncs/zephyr/soc/native/inf_clock/Kconfig"
osource "/home/vinter/ncs/zephyr/soc/microchip/miv/Kconfig"
osource "/home/vinter/ncs/zephyr/soc/microchip/mec/Kconfig"
osource "/home/vinter/ncs/zephyr/soc/lowrisc/opentitan/Kconfig"
osource "/home/vinter/ncs/zephyr/soc/litex/litex_vexriscv/Kconfig"
osource "/home/vinter/ncs/zephyr/soc/ite/ec/Kconfig"
osource "/home/vinter/ncs/zephyr/soc/intel/raptor_lake/Kconfig"
osource "/home/vinter/ncs/zephyr/soc/intel/lakemont/Kconfig"
osource "/home/vinter/ncs/zephyr/soc/intel/intel_socfpga_std/Kconfig"
osource "/home/vinter/ncs/zephyr/soc/intel/intel_socfpga/Kconfig"
osource "/home/vinter/ncs/zephyr/soc/intel/intel_niosv/Kconfig"
osource "/home/vinter/ncs/zephyr/soc/intel/intel_ish/Kconfig"
osource "/home/vinter/ncs/zephyr/soc/intel/intel_adsp/Kconfig"
osource "/home/vinter/ncs/zephyr/soc/intel/elkhart_lake/Kconfig"
osource "/home/vinter/ncs/zephyr/soc/intel/atom/Kconfig"
osource "/home/vinter/ncs/zephyr/soc/intel/apollo_lake/Kconfig"
osource "/home/vinter/ncs/zephyr/soc/intel/alder_lake/Kconfig"
osource "/home/vinter/ncs/zephyr/soc/infineon/cat3/Kconfig"
osource "/home/vinter/ncs/zephyr/soc/infineon/cat1a/Kconfig"
osource "/home/vinter/ncs/zephyr/soc/gd/gd32/Kconfig"
osource "/home/vinter/ncs/zephyr/soc/gaisler/leon3/Kconfig"
osource "/home/vinter/ncs/zephyr/soc/gaisler/gr716a/Kconfig"
osource "/home/vinter/ncs/zephyr/soc/espressif/Kconfig"
osource "/home/vinter/ncs/zephyr/soc/ene/kb1200/Kconfig"
osource "/home/vinter/ncs/zephyr/soc/efinix/sapphire/Kconfig"
osource "/home/vinter/ncs/zephyr/soc/cdns/xtensa_sample_controller/Kconfig"
osource "/home/vinter/ncs/zephyr/soc/cdns/dc233c/Kconfig"
osource "/home/vinter/ncs/zephyr/soc/brcm/bcmvk/Kconfig"
osource "/home/vinter/ncs/zephyr/soc/brcm/bcm2712/Kconfig"
osource "/home/vinter/ncs/zephyr/soc/brcm/bcm2711/Kconfig"
osource "/home/vinter/ncs/zephyr/soc/atmel/sam0/Kconfig"
osource "/home/vinter/ncs/zephyr/soc/atmel/sam/Kconfig"
osource "/home/vinter/ncs/zephyr/soc/aspeed/Kconfig"
osource "/home/vinter/ncs/zephyr/soc/arm/Kconfig"
osource "/home/vinter/ncs/zephyr/soc/arm/beetle/Kconfig"
osource "/home/vinter/ncs/zephyr/soc/andestech/Kconfig"
osource "/home/vinter/ncs/zephyr/soc/ambiq/Kconfig"
osource "/home/vinter/ncs/zephyr/soc/altr/zephyr_nios2f/Kconfig"
osource "/home/vinter/ncs/zephyr/soc/altr/qemu_nios2/Kconfig"
```
