## build/Kconfig/soc/Kconfig.soc
```kconfig
# Load SoC Kconfig descriptions.
osource "/home/vinter/ncs/zephyr/soc/xlnx/zynqmp/Kconfig.soc"
osource "/home/vinter/ncs/zephyr/soc/xlnx/zynq7000/Kconfig.soc"
osource "/home/vinter/ncs/zephyr/soc/xen/Kconfig.soc"
osource "/home/vinter/ncs/zephyr/soc/ti/simplelink/Kconfig.soc"
osource "/home/vinter/ncs/zephyr/soc/ti/lm3s6965/Kconfig.soc"
osource "/home/vinter/ncs/zephyr/soc/ti/k3/Kconfig.soc"
osource "/home/vinter/ncs/zephyr/soc/telink/tlsr/Kconfig.soc"
osource "/home/vinter/ncs/zephyr/soc/starfive/jh71xx/Kconfig.soc"
osource "/home/vinter/ncs/zephyr/soc/st/stm32/Kconfig.soc"
osource "/home/vinter/ncs/zephyr/soc/snps/qemu_arc/Kconfig.soc"
osource "/home/vinter/ncs/zephyr/soc/snps/nsim/Kconfig.soc"
osource "/home/vinter/ncs/zephyr/soc/snps/hsdk4xd/Kconfig.soc"
osource "/home/vinter/ncs/zephyr/soc/snps/hsdk/Kconfig.soc"
osource "/home/vinter/ncs/zephyr/soc/snps/emsk/Kconfig.soc"
osource "/home/vinter/ncs/zephyr/soc/snps/emsdp/Kconfig.soc"
osource "/home/vinter/ncs/zephyr/soc/snps/arc_iot/Kconfig.soc"
osource "/home/vinter/ncs/zephyr/soc/silabs/Kconfig.soc"
osource "/home/vinter/ncs/zephyr/soc/sifive/sifive_freedom/Kconfig.soc"
osource "/home/vinter/ncs/zephyr/soc/rockchip/Kconfig.soc"
osource "/home/vinter/ncs/zephyr/soc/renode/riscv_virtual/Kconfig.soc"
osource "/home/vinter/ncs/zephyr/soc/renesas/smartbond/Kconfig.soc"
osource "/home/vinter/ncs/zephyr/soc/renesas/rzt2m/Kconfig.soc"
osource "/home/vinter/ncs/zephyr/soc/renesas/rcar/Kconfig.soc"
osource "/home/vinter/ncs/zephyr/soc/renesas/ra/Kconfig.soc"
osource "/home/vinter/ncs/zephyr/soc/raspberrypi/Kconfig.soc"
osource "/home/vinter/ncs/zephyr/soc/quicklogic/eos_s3/Kconfig.soc"
osource "/home/vinter/ncs/zephyr/soc/qemu/virt_riscv/Kconfig.soc"
osource "/home/vinter/ncs/zephyr/soc/qemu/malta/Kconfig.soc"
osource "/home/vinter/ncs/zephyr/soc/openisa/rv32m1/Kconfig.soc"
osource "/home/vinter/ncs/zephyr/soc/nxp/s32/Kconfig.soc"
osource "/home/vinter/ncs/zephyr/soc/nxp/rw/Kconfig.soc"
osource "/home/vinter/ncs/zephyr/soc/nxp/mcx/Kconfig.soc"
osource "/home/vinter/ncs/zephyr/soc/nxp/lpc/Kconfig.soc"
osource "/home/vinter/ncs/zephyr/soc/nxp/layerscape/Kconfig.soc"
osource "/home/vinter/ncs/zephyr/soc/nxp/kinetis/Kconfig.soc"
osource "/home/vinter/ncs/zephyr/soc/nxp/imxrt/Kconfig.soc"
osource "/home/vinter/ncs/zephyr/soc/nxp/imx/Kconfig.soc"
osource "/home/vinter/ncs/zephyr/soc/nuvoton/numicro/Kconfig.soc"
osource "/home/vinter/ncs/zephyr/soc/nuvoton/numaker/Kconfig.soc"
osource "/home/vinter/ncs/zephyr/soc/nuvoton/npcx/Kconfig.soc"
osource "/home/vinter/ncs/zephyr/soc/nordic/Kconfig.soc"
osource "/home/vinter/ncs/zephyr/soc/neorv32/Kconfig.soc"
osource "/home/vinter/ncs/zephyr/soc/native/inf_clock/Kconfig.soc"
osource "/home/vinter/ncs/zephyr/soc/microchip/miv/Kconfig.soc"
osource "/home/vinter/ncs/zephyr/soc/microchip/mec/Kconfig.soc"
osource "/home/vinter/ncs/zephyr/soc/lowrisc/opentitan/Kconfig.soc"
osource "/home/vinter/ncs/zephyr/soc/litex/litex_vexriscv/Kconfig.soc"
osource "/home/vinter/ncs/zephyr/soc/ite/ec/Kconfig.soc"
osource "/home/vinter/ncs/zephyr/soc/intel/raptor_lake/Kconfig.soc"
osource "/home/vinter/ncs/zephyr/soc/intel/lakemont/Kconfig.soc"
osource "/home/vinter/ncs/zephyr/soc/intel/intel_socfpga_std/Kconfig.soc"
osource "/home/vinter/ncs/zephyr/soc/intel/intel_socfpga/Kconfig.soc"
osource "/home/vinter/ncs/zephyr/soc/intel/intel_niosv/Kconfig.soc"
osource "/home/vinter/ncs/zephyr/soc/intel/intel_ish/Kconfig.soc"
osource "/home/vinter/ncs/zephyr/soc/intel/intel_adsp/Kconfig.soc"
osource "/home/vinter/ncs/zephyr/soc/intel/elkhart_lake/Kconfig.soc"
osource "/home/vinter/ncs/zephyr/soc/intel/atom/Kconfig.soc"
osource "/home/vinter/ncs/zephyr/soc/intel/apollo_lake/Kconfig.soc"
osource "/home/vinter/ncs/zephyr/soc/intel/alder_lake/Kconfig.soc"
osource "/home/vinter/ncs/zephyr/soc/infineon/cat3/Kconfig.soc"
osource "/home/vinter/ncs/zephyr/soc/infineon/cat1a/Kconfig.soc"
osource "/home/vinter/ncs/zephyr/soc/gd/gd32/Kconfig.soc"
osource "/home/vinter/ncs/zephyr/soc/gaisler/leon3/Kconfig.soc"
osource "/home/vinter/ncs/zephyr/soc/gaisler/gr716a/Kconfig.soc"
osource "/home/vinter/ncs/zephyr/soc/espressif/Kconfig.soc"
osource "/home/vinter/ncs/zephyr/soc/ene/kb1200/Kconfig.soc"
osource "/home/vinter/ncs/zephyr/soc/efinix/sapphire/Kconfig.soc"
osource "/home/vinter/ncs/zephyr/soc/cdns/xtensa_sample_controller/Kconfig.soc"
osource "/home/vinter/ncs/zephyr/soc/cdns/dc233c/Kconfig.soc"
osource "/home/vinter/ncs/zephyr/soc/brcm/bcmvk/Kconfig.soc"
osource "/home/vinter/ncs/zephyr/soc/brcm/bcm2712/Kconfig.soc"
osource "/home/vinter/ncs/zephyr/soc/brcm/bcm2711/Kconfig.soc"
osource "/home/vinter/ncs/zephyr/soc/atmel/sam0/Kconfig.soc"
osource "/home/vinter/ncs/zephyr/soc/atmel/sam/Kconfig.soc"
osource "/home/vinter/ncs/zephyr/soc/aspeed/Kconfig.soc"
osource "/home/vinter/ncs/zephyr/soc/arm/Kconfig.soc"
osource "/home/vinter/ncs/zephyr/soc/arm/beetle/Kconfig.soc"
osource "/home/vinter/ncs/zephyr/soc/andestech/Kconfig.soc"
osource "/home/vinter/ncs/zephyr/soc/ambiq/Kconfig.soc"
osource "/home/vinter/ncs/zephyr/soc/altr/zephyr_nios2f/Kconfig.soc"
osource "/home/vinter/ncs/zephyr/soc/altr/qemu_nios2/Kconfig.soc"
```

## build/Kconfig/soc/Kconfig.sysbuild
```kconfig
# Load SoC sysbuild Kconfig descriptions.
osource "/home/vinter/ncs/zephyr/soc/xlnx/zynqmp/Kconfig.sysbuild"
osource "/home/vinter/ncs/zephyr/soc/xlnx/zynq7000/Kconfig.sysbuild"
osource "/home/vinter/ncs/zephyr/soc/xen/Kconfig.sysbuild"
osource "/home/vinter/ncs/zephyr/soc/ti/simplelink/Kconfig.sysbuild"
osource "/home/vinter/ncs/zephyr/soc/ti/lm3s6965/Kconfig.sysbuild"
osource "/home/vinter/ncs/zephyr/soc/ti/k3/Kconfig.sysbuild"
osource "/home/vinter/ncs/zephyr/soc/telink/tlsr/Kconfig.sysbuild"
osource "/home/vinter/ncs/zephyr/soc/starfive/jh71xx/Kconfig.sysbuild"
osource "/home/vinter/ncs/zephyr/soc/st/stm32/Kconfig.sysbuild"
osource "/home/vinter/ncs/zephyr/soc/snps/qemu_arc/Kconfig.sysbuild"
osource "/home/vinter/ncs/zephyr/soc/snps/nsim/Kconfig.sysbuild"
osource "/home/vinter/ncs/zephyr/soc/snps/hsdk4xd/Kconfig.sysbuild"
osource "/home/vinter/ncs/zephyr/soc/snps/hsdk/Kconfig.sysbuild"
osource "/home/vinter/ncs/zephyr/soc/snps/emsk/Kconfig.sysbuild"
osource "/home/vinter/ncs/zephyr/soc/snps/emsdp/Kconfig.sysbuild"
osource "/home/vinter/ncs/zephyr/soc/snps/arc_iot/Kconfig.sysbuild"
osource "/home/vinter/ncs/zephyr/soc/silabs/Kconfig.sysbuild"
osource "/home/vinter/ncs/zephyr/soc/sifive/sifive_freedom/Kconfig.sysbuild"
osource "/home/vinter/ncs/zephyr/soc/rockchip/Kconfig.sysbuild"
osource "/home/vinter/ncs/zephyr/soc/renode/riscv_virtual/Kconfig.sysbuild"
osource "/home/vinter/ncs/zephyr/soc/renesas/smartbond/Kconfig.sysbuild"
osource "/home/vinter/ncs/zephyr/soc/renesas/rzt2m/Kconfig.sysbuild"
osource "/home/vinter/ncs/zephyr/soc/renesas/rcar/Kconfig.sysbuild"
osource "/home/vinter/ncs/zephyr/soc/renesas/ra/Kconfig.sysbuild"
osource "/home/vinter/ncs/zephyr/soc/raspberrypi/Kconfig.sysbuild"
osource "/home/vinter/ncs/zephyr/soc/quicklogic/eos_s3/Kconfig.sysbuild"
osource "/home/vinter/ncs/zephyr/soc/qemu/virt_riscv/Kconfig.sysbuild"
osource "/home/vinter/ncs/zephyr/soc/qemu/malta/Kconfig.sysbuild"
osource "/home/vinter/ncs/zephyr/soc/openisa/rv32m1/Kconfig.sysbuild"
osource "/home/vinter/ncs/zephyr/soc/nxp/s32/Kconfig.sysbuild"
osource "/home/vinter/ncs/zephyr/soc/nxp/rw/Kconfig.sysbuild"
osource "/home/vinter/ncs/zephyr/soc/nxp/mcx/Kconfig.sysbuild"
osource "/home/vinter/ncs/zephyr/soc/nxp/lpc/Kconfig.sysbuild"
osource "/home/vinter/ncs/zephyr/soc/nxp/layerscape/Kconfig.sysbuild"
osource "/home/vinter/ncs/zephyr/soc/nxp/kinetis/Kconfig.sysbuild"
osource "/home/vinter/ncs/zephyr/soc/nxp/imxrt/Kconfig.sysbuild"
osource "/home/vinter/ncs/zephyr/soc/nxp/imx/Kconfig.sysbuild"
osource "/home/vinter/ncs/zephyr/soc/nuvoton/numicro/Kconfig.sysbuild"
osource "/home/vinter/ncs/zephyr/soc/nuvoton/numaker/Kconfig.sysbuild"
osource "/home/vinter/ncs/zephyr/soc/nuvoton/npcx/Kconfig.sysbuild"
osource "/home/vinter/ncs/zephyr/soc/nordic/Kconfig.sysbuild"
osource "/home/vinter/ncs/zephyr/soc/neorv32/Kconfig.sysbuild"
osource "/home/vinter/ncs/zephyr/soc/native/inf_clock/Kconfig.sysbuild"
osource "/home/vinter/ncs/zephyr/soc/microchip/miv/Kconfig.sysbuild"
osource "/home/vinter/ncs/zephyr/soc/microchip/mec/Kconfig.sysbuild"
osource "/home/vinter/ncs/zephyr/soc/lowrisc/opentitan/Kconfig.sysbuild"
osource "/home/vinter/ncs/zephyr/soc/litex/litex_vexriscv/Kconfig.sysbuild"
osource "/home/vinter/ncs/zephyr/soc/ite/ec/Kconfig.sysbuild"
osource "/home/vinter/ncs/zephyr/soc/intel/raptor_lake/Kconfig.sysbuild"
osource "/home/vinter/ncs/zephyr/soc/intel/lakemont/Kconfig.sysbuild"
osource "/home/vinter/ncs/zephyr/soc/intel/intel_socfpga_std/Kconfig.sysbuild"
osource "/home/vinter/ncs/zephyr/soc/intel/intel_socfpga/Kconfig.sysbuild"
osource "/home/vinter/ncs/zephyr/soc/intel/intel_niosv/Kconfig.sysbuild"
osource "/home/vinter/ncs/zephyr/soc/intel/intel_ish/Kconfig.sysbuild"
osource "/home/vinter/ncs/zephyr/soc/intel/intel_adsp/Kconfig.sysbuild"
osource "/home/vinter/ncs/zephyr/soc/intel/elkhart_lake/Kconfig.sysbuild"
osource "/home/vinter/ncs/zephyr/soc/intel/atom/Kconfig.sysbuild"
osource "/home/vinter/ncs/zephyr/soc/intel/apollo_lake/Kconfig.sysbuild"
osource "/home/vinter/ncs/zephyr/soc/intel/alder_lake/Kconfig.sysbuild"
osource "/home/vinter/ncs/zephyr/soc/infineon/cat3/Kconfig.sysbuild"
osource "/home/vinter/ncs/zephyr/soc/infineon/cat1a/Kconfig.sysbuild"
osource "/home/vinter/ncs/zephyr/soc/gd/gd32/Kconfig.sysbuild"
osource "/home/vinter/ncs/zephyr/soc/gaisler/leon3/Kconfig.sysbuild"
osource "/home/vinter/ncs/zephyr/soc/gaisler/gr716a/Kconfig.sysbuild"
osource "/home/vinter/ncs/zephyr/soc/espressif/Kconfig.sysbuild"
osource "/home/vinter/ncs/zephyr/soc/ene/kb1200/Kconfig.sysbuild"
osource "/home/vinter/ncs/zephyr/soc/efinix/sapphire/Kconfig.sysbuild"
osource "/home/vinter/ncs/zephyr/soc/cdns/xtensa_sample_controller/Kconfig.sysbuild"
osource "/home/vinter/ncs/zephyr/soc/cdns/dc233c/Kconfig.sysbuild"
osource "/home/vinter/ncs/zephyr/soc/brcm/bcmvk/Kconfig.sysbuild"
osource "/home/vinter/ncs/zephyr/soc/brcm/bcm2712/Kconfig.sysbuild"
osource "/home/vinter/ncs/zephyr/soc/brcm/bcm2711/Kconfig.sysbuild"
osource "/home/vinter/ncs/zephyr/soc/atmel/sam0/Kconfig.sysbuild"
osource "/home/vinter/ncs/zephyr/soc/atmel/sam/Kconfig.sysbuild"
osource "/home/vinter/ncs/zephyr/soc/aspeed/Kconfig.sysbuild"
osource "/home/vinter/ncs/zephyr/soc/arm/Kconfig.sysbuild"
osource "/home/vinter/ncs/zephyr/soc/arm/beetle/Kconfig.sysbuild"
osource "/home/vinter/ncs/zephyr/soc/andestech/Kconfig.sysbuild"
osource "/home/vinter/ncs/zephyr/soc/ambiq/Kconfig.sysbuild"
osource "/home/vinter/ncs/zephyr/soc/altr/zephyr_nios2f/Kconfig.sysbuild"
osource "/home/vinter/ncs/zephyr/soc/altr/qemu_nios2/Kconfig.sysbuild"
```
